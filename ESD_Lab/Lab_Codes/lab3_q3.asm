	AREA RESET, DATA, READONLY
	EXPORT __Vectors

__Vectors
    DCD 0x10001000      ; STACK POINTER VALUE WHEN STACK IS EMPTY
    DCD Reset_Handler   ; RESET VECTOR

	ALIGN
	AREA mycode, CODE, READONLY
ENTRY
	EXPORT Reset_Handler

Reset_Handler

	LDR R0,=VAL1
	LDR R1,=VAL2
	LDR R2,=RES
	MOV R3,#4
	MOV R4,#0x20000000
	MSR xPSR,R4

BACK LDR R4,[R0],#4
	LDR R5, [R1], #4
	SBC R6,R4,R5
	STR R6, [R2], #4
	SUB R3, #1
	TEQ R3, #0
	BNE BACK
	ADC R9,#0
	STR R9,[R2]
STOP
	B STOP

VAL1 DCD 0x11111111, 0x11111111, 0x11111111, 0x11111111
VAL2 DCD 0xABABABAB, 0xBCBCBCBC, 0xCDCDCDCD, 0xDEDEDEDE
	AREA DATASEG, DATA, READWRITE
RES	DCD 0, 0, 0, 0		;DST location in Data segment
	END